## dahlia50happy-akdk/boards/shields/dahlia50happy/Kconfig.defconfig
```kconfig
if SHIELD_DAHLIA50HAPPY_LEFT

config ZMK_KEYBOARD_NAME
    default "dahlia50happy"

endif

if SHIELD_DAHLIA50HAPPY_LEFT || SHIELD_DAHLIA50HAPPY_RIGHT

config ZMK_SPLIT
    default y

endif
```

## dahlia50happy-akdk/boards/shields/dahlia50happy/Kconfig.shield
```kconfig
config SHIELD_DAHLIA50HAPPY_LEFT
    def_bool $(shields_list_contains,dahlia50happy_left)
config SHIELD_DAHLIA50HAPPY_RIGHT
    def_bool $(shields_list_contains,dahlia50happy_right)
```
